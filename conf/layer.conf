## conf/layer.conf
```bitbake
# We have a conf and classes directory, add to BBPATH
BBPATH .= ":${LAYERDIR}"

# We have recipes-* directories, add to BBFILES
BBFILES += "${LAYERDIR}/recipes-*/*/*.bb \
	${LAYERDIR}/recipes-*/*/*.bbappend"

BBFILE_COLLECTIONS += "random"
BBFILE_PATTERN_random = "^${LAYERDIR}/"
BBFILE_PRIORITY_random = "10"
LAYERSERIES_COMPAT_random = "zeus"

LICENSE_PATH += "${LAYERDIR}/custom-licenses"
```
